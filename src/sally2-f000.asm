serin		equ	03
serout		equ	serin+3
serhex		equ	serout+3
sercmd		equ	serhex+3
serdump		equ	sercmd+3
serrecv		equ	serdump+3
;

		ORG	0f000h
;
;
;
		INCLUDE	"EQUS.MAC"
		INCLUDE	"GLOBAL.MAC"
		
MONITOR		equ	$
		jp	RESTART
		jp	MINIMON		;MONITOR WARM ENTRY POINT
CSV:		jp	CONST		;CONSOLE STATUS
CIV:		jp	CONIN		;CONSOLE INPUT
COV:		jp	CONOUT		;CONSOLE OUTPUT
DISKV:		jp	DISKDVR		;DISK HANDLER
LISTV:		jp	CENTOUT		;PARALLEL PRINTER OUT
		jp	CENTRDY		;PARALLEL PRINTER STATUS
RENEW:		jp	CINIT2		;CONSOLE PORT INITAILZATION
;	
;
;
RESTART:	
		di
		xor	A
		out	(BANKSW),A
		jp	0		;JUMP TO ROM
;	
;	
;	
		include	"DISKIO.MAC"
		include	"minimon.mac"
		include	"PRINTER.MAC"
		DEFB 95h                ; **** Exists on original ROM? ****
		dw	0, 0, 0, 0, 0, 0
;		defs	(($ and 0ff00h)+100h)-$
		INCLUDE	"SERIAL.MAC"
;	
;		CODE PAST THIS POINT IS ONLY USED IN ATARI DISK MODE
;	
		INCLUDE	"BITBANG.MAC"
		INCLUDE	"ATARI.MAC"
		INCLUDE	"FORMAT.MAC"

		DEFB	255,255,255,255	;HEAD POSITIONS FOR 4 DRIVES
		DEFB	0,0,0,0		;DENSITY/TYPE/SELECT BITS FOR 4 DRIVES
		DEFB	16,16,16,16	;SETTLING DELAYS / STEP RATES TABLE
		DEFB	0		;CURRENTLY SELECTED DISK#
		DEFB	255		;TRACK POSITION OF SELECTED DRIVE
		DEFB	1		;DRIVES-OFF FLAG FROM DISK TIMER IRQ
		DEFB	00000000B	;COPY OF DISK CONTROL LATCH
		DEFW	0		;DISK SPIN PERIOD
		DEFB	50		;HEAD LOAD DELAY
		DEFB	10		;MAX NUMBER OF READ/WRITE RETRIES
		DEFB	0,0,0,0		;ROOM FOR EXPANSION
					;24 bytes
					
		DEFW	IDTAB		;POINTER TO DEVICE ID TABLE
		DEFW	PWRWAIT		;POINTER FOR ATARI TASK STATE MACHINE
		DEFW	DUMMY		;POINTER FOR EXTRA TASK PROCESSOR
		DEFB	2,CR,LF,0,0	;PRINTER NEWLINE CHARACTERS
		DEFB	0,0,60,0	;PRINTER STATUS FRAME
		DEFB	10000000B	;MASK ALL BITS BUT 'BUSY'
		DEFB	00000000B	;COMPARE TO ZERO FOR READY
		DEFW	FMTS		;POINTER TO STANDARD FORMAT TABLES
		DEFW	IOBUFF+(2*LEN)	;PUT PRINT BUFFER AFTER HERE
		DEFW	4095		;MAX BUFFER INDEX OFFSET
					;23 bytes
					;--------
					;47 bytes
					;========
;--------------------------------------------------
; set to zero in startup code until 0ffffh
;--------------------------------------------------
ff2a:		db	73h			
     		nop
     		nop
     		nop
     		nop
     		nop
     		nop
     		nop
ff33:     	nop
     		nop
     		nop
     		nop
		db	"ROLLI 1 Rev 1.00"
		